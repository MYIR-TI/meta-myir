## meta-myir-bsp/conf/layer.conf
```bitbake
# We have a conf and classes directory, append to BBPATH
BBPATH .= ":${LAYERDIR}"
METATIBASE := '${@os.path.normpath("${LAYERDIR}/")}'

# We have a recipes directory, add to BBFILES
BBFILES += "${LAYERDIR}/recipes*/*/*.bb ${LAYERDIR}/recipes*/*/*.bbappend"

BBFILE_COLLECTIONS += "meta-myir-bsp"
BBFILE_PATTERN_meta-myir-bsp := "^${LAYERDIR}/"
BBFILE_PRIORITY_meta-myir-bsp = "6"

LAYERSERIES_COMPAT_meta-myir-bsp = "scarthgap"

LICENSE_PATH += "${LAYERDIR}/licenses"

LAYERDEPENDS_meta-myir-bsp = " \
    core \
    meta-arm \
"

SIGGEN_EXCLUDERECIPES_ABISAFE += " \
    mesa-pvr \
"

HOSTTOOLS_NONFATAL += "truncate xxd comm"

TI_COMMON_DEPLOY ?= "${TOPDIR}/deploy-ti"
DEPLOY_DIR_IMAGE:ti-soc = "${TI_COMMON_DEPLOY}/images/${MACHINE}"
SDK_DEPLOY:ti-soc = "${TI_COMMON_DEPLOY}/sdk"
PSEUDO_IGNORE_PATHS:append:ti-soc = ",${TI_COMMON_DEPLOY}"
```

## meta-myir-bsp/conf/machine/myd-am62x-rt-emmc.conf
```bitbake
#@TYPE: Machine
#@NAME: MYD-AM62X
#@DESCRIPTION: Machine configuration for the MYIR MYD-AM62X board

require conf/machine/include/am62xx-rt.inc
require conf/machine/include/ti-extras.inc

KERNEL_DEVICETREE_PREFIX = " \
    myir/myd-am62x \
"

KERNEL_DEVICETREE = " \
    myir/myd-am62x-6254.dtb \
    myir/myd-am62x-lvds-j6.dtbo \
    myir/myd-am62x-lvds-j5.dtbo \
    myir/myd-am62x-dual-lvds.dtbo \
"


KERNEL_DEVICETREE:append = " \
    myir/myd-am62x-6254.dtb \
    myir/myd-am62x-lvds-j6.dtbo \
    myir/myd-am62x-lvds-j5.dtbo \
    myir/myd-am62x-dual-lvds.dtbo \
"

FIT_CONF_DEFAULT_DTB = "myir/myd-am62x-6254.dtb"

UBOOT_MACHINE = "myc_am62x_a53_emmc_defconfig"

# Override to use GP version of tiboot3 instead of default HS-FS
IMAGE_BOOT_FILES:remove = "tiboot3-am62x-hs-fs-evm.bin"
IMAGE_BOOT_FILES:prepend = "tiboot3-am62x-gp-evm.bin "

DEFAULT_TIMEZONE = "Asia/Shanghai"
```

## meta-myir-bsp/conf/machine/myd-am62x.conf
```bitbake
#@TYPE: Machine
#@NAME: MYD-AM62X
#@DESCRIPTION: Machine configuration for the MYIR MYD-AM62X board

require conf/machine/include/am62xx.inc
require conf/machine/include/ti-extras.inc

KERNEL_DEVICETREE_PREFIX = " \
    ti/k3-am625 \
    ti/k3-am62x-sk \
    myir/myd-am62x \
"

KERNEL_DEVICETREE = " \
    ti/k3-am625-beagleplay-csi2-ov5640.dtbo \
    ti/k3-am625-beagleplay-csi2-tevi-ov5640.dtbo \
    ti/k3-am625-beagleplay.dtb \
    ti/k3-am625-phyboard-lyra-1-4-ghz-opp.dtbo \
    ti/k3-am625-phyboard-lyra-rdk.dtb \
    ti/k3-am625-sk.dtb \
    ti/k3-am625-verdin-nonwifi-dahlia.dtb \
    ti/k3-am625-verdin-nonwifi-dev.dtb \
    ti/k3-am625-verdin-nonwifi-mallow.dtb \
    ti/k3-am625-verdin-nonwifi-yavia.dtb \
    ti/k3-am625-verdin-wifi-dahlia.dtb \
    ti/k3-am625-verdin-wifi-dev.dtb \
    ti/k3-am625-verdin-wifi-mallow.dtb \
    ti/k3-am625-verdin-wifi-yavia.dtb \
    ti/k3-am62x-sk-csi2-imx219.dtbo \
    ti/k3-am62x-sk-csi2-ov5640.dtbo \
    ti/k3-am62x-sk-csi2-tevi-ov5640.dtbo \
    ti/k3-am62x-sk-hdmi-audio.dtbo \
    myir/myd-am62x-6254.dtb \
    myir/myd-am62x-lvds-j6.dtbo \
    myir/myd-am62x-lvds-j5.dtbo \
    myir/myd-am62x-dual-lvds.dtbo \
"


KERNEL_DEVICETREE:append = " \
    myir/myd-am62x-6254.dtb \
    myir/myd-am62x-lvds-j6.dtbo \
    myir/myd-am62x-lvds-j5.dtbo \
    myir/myd-am62x-dual-lvds.dtbo \
"

FIT_CONF_DEFAULT_DTB = "myir/myd-am62x-6254.dtb"

UBOOT_MACHINE = "myc_am62x_a53_defconfig"
```

## meta-ti-bsp/conf/machine/myd-ym62lx-rt-emmc.conf
```bitbake
#@TYPE: Machine
#@NAME: MYD-YM62LX eMMC
#@DESCRIPTION: Machine configuration for the MYIR MYD-YM62LX eMMC Board

require conf/machine/include/am62lxx-rt.inc
require conf/machine/include/ti-extras.inc

IMAGE_FSTYPES += "ubifs ubi"

MKUBIFS_ARGS ?= "-F -m 4096 -e 258048 -c 8500"

UBINIZE_ARGS ?= "-m 4096 -p 256KiB -s 1024 -O 1024"

KERNEL_DEVICETREE_PREFIX = " \
    myir/myd-ym62lx \
"

KERNEL_DEVICETREE = ""

UBOOT_MACHINE = "myd_ym62lx_emmc_defconfig"

TF_A_DTB_NAME = "myd-ym62lx-ddr-1g.dtb"

DEFAULT_TIMEZONE = "Asia/Shanghai"
```
