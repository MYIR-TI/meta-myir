## meta-myir-extras/conf/layer.conf
```bitbake
# We have a conf and classes directory, append to BBPATH
BBPATH .= ":${LAYERDIR}"
METATIBASE := '${@os.path.normpath("${LAYERDIR}/")}'

# We have a recipes directory, add to BBFILES
BBFILES += "${LAYERDIR}/recipes*/*/*.bb ${LAYERDIR}/recipes*/*/*.bbappend"

BBFILE_COLLECTIONS += "meta-myir-extras"
BBFILE_PATTERN_meta-myir-extras := "^${LAYERDIR}/"
BBFILE_PRIORITY_meta-myir-extras = "6"

LAYERSERIES_COMPAT_meta-myir-extras = "kirkstone langdale"

LICENSE_PATH += "${LAYERDIR}/licenses"

LAYERDEPENDS_meta-myir-extras = " \
    meta-myir-bsp \
"
```
